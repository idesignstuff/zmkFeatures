## app/boards/shields/anduril/Kconfig.defconfig
```kconfig
# Copyright (c) 2022 The ZMK Contributors
# SPDX-License-Identifier: MIT

if SHIELD_ANDURIL

config ZMK_KEYBOARD_NAME
    default "Anduril"

endif
```
